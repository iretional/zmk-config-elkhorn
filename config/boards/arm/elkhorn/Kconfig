## config/boards/arm/elkhorn/Kconfig
```kconfig
#
# Copyright (c) 2022 The ZMK Contributors
# SPDX-License-Identifier: MIT
#

config BOARD_ELKHRON_LEFT
    bool

config BOARD_ELKHRON_RIGHT
    bool
```

## config/boards/arm/elkhorn/Kconfig.board
```kconfig
#
# Copyright (c) 2023 Ireh Choi
# SPDX-License-Identifier: MIT
#

config BOARD_ELKHRON_V1_LEFT
    bool "elkhorn left v1"
    depends on SOC_NRF52833_QIAA
    select BOARD_ELKHRON_LEFT

config BOARD_ELKHRON_V1_RIGHT
    bool "elkhorn right v1"
    depends on SOC_NRF52833_QIAA
    select BOARD_ELKHRON_RIGHT
```

## config/boards/arm/elkhorn/Kconfig.defconfig
```kconfig
if BOARD_ELKHRON_LEFT

config ZMK_KEYBOARD_NAME
    default "Elkhorn"

config ZMK_SPLIT_ROLE_CENTRAL
    default y

endif

if BOARD_ELKHRON_LEFT || BOARD_ELKHRON_RIGHT

config BOARD
    default "elkhorn"

config ZMK_SPLIT
    default y

endif
```

## config/boards/arm/elkhorn/Kconfig.shield
```kconfig
config SHIELD_ELKHRON_V1_LEFT
    def_bool $(shields_list_contains,elkhorn_left)

config SHIELD_ELKHRON_V1_RIGHT
    def_bool $(shields_list_contains,elkhorn_right)
```
