
/*
 * Copyright (c) 2023 Ireh Choi
 *
 * SPDX-License-Identifier: MIT
 */

#include "elkhorn.dtsi" // Notice that the main dtsi files are included in the overlay.

&default_transform { // The matrix transform for this board is 8 columns over because the left half is 8 columns wide according to the matrix.
    col-offset = <8>;
};

&kscan0 {
    col-gpios
        = <&gpio0 20 GPIO_ACTIVE_HIGH> // CLE1 in the schematic
        , <&gpio0 4 GPIO_ACTIVE_HIGH> // CLE2 in the schematic
        , <&gpio0 31 GPIO_ACTIVE_HIGH> // CLE3 in the schematic
        , <&gpio0 30 GPIO_ACTIVE_HIGH> // CLE4 in the schematic
        , <&gpio0 29 GPIO_ACTIVE_HIGH> // CLE5 in the schematic
        , <&gpio0 28 GPIO_ACTIVE_HIGH> // CLE6 in the schematic
        , <&gpio0 2 GPIO_ACTIVE_HIGH> // CLE7 in the schematic
        , <&gpio0 3 GPIO_ACTIVE_HIGH> // CLE8 in the schematic
        ;
};